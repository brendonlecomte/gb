#include "memory.h"
#include "memory_locations.h"
#include "cart.h"
#include "timer.h"
#include "io.h"
#include <string.h>
#include <stdint.h>

const uint8_t boot[256] = {
    0x31, 0xFE, 0xFF, 0xAF, 0x21, 0xFF, 0x9F, 0x32, 0xCB, 0x7C, 0x20, 0xFB, 0x21, 0x26, 0xFF, 0x0E,
    0x11, 0x3E, 0x80, 0x32, 0xE2, 0x0C, 0x3E, 0xF3, 0xE2, 0x32, 0x3E, 0x77, 0x77, 0x3E, 0xFC, 0xE0,
    0x47, 0x11, 0x04, 0x01, 0x21, 0x10, 0x80, 0x1A, 0xCD, 0x95, 0x00, 0xCD, 0x96, 0x00, 0x13, 0x7B,
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    0xF5, 0x06, 0x19, 0x78, 0x86, 0x23, 0x05, 0x20, 0xFB, 0x86, 0x00, 0x00, 0x3E, 0x01, 0xE0, 0x50
};

static memory_t _memory;
memory_t *memory = &_memory;

void memory_init(memory_t *mem) {
  memset(mem->memory, 0x00, FULL_MEMORY);
  mem->cart = &mem->memory[0];
  cart_load();
  mem->cart_header = &mem->memory[0x100];
  mem->vram = &mem->memory[0x8000];
  mem->eram = &mem->memory[0xA000];
  mem->ram = &mem->memory[0xC000];
  mem->oam = &mem->memory[0xFE00];
  mem->io = &mem->memory[0xFF00];
  mem->hram = &mem->memory[0xFF80];
  memset(mem->vram, 0x55, 0x2000);
  mem->memory[JOYP] = 0xFF; //make sure the keys are "unpressed" at boot
#if BOOT_ROM
  mem->inBoot = true;
#else
  mem->inBoot = false;
  mem->memory[LCDC] = 0x91;
#endif
}

uint8_t memory_read8(memory_t *mem, uint16_t addr) {
    //Read from the Boot Rom
    if(addr < 0x0100 && mem->inBoot){
        return boot[addr];
    }
    uint8_t val;
    uint8_t joyp;
    uint8_t temp;
    // Read from the cart
    switch(addr)
    {
        case 0x0000 ... 0x7FFF:
             val = cart_read(addr);
             break;
        case JOYP:
            joyp = mem->memory[addr];
            if((joyp&0x30) == 0x20){ //directions selected
              temp = io_get_direction();
            }
            else if((joyp&0x30) == 0x10) { //buttons selected
              temp = io_get_buttons();
            }
            else {
              temp = 0x0F; //nothing pressed
            }
            val = (joyp&0xF0) | (temp&0x0F);
            break;
        default:
            val = mem->memory[addr];
            break;
    }
    return val;
}

uint16_t memory_read16(memory_t *mem, uint16_t addr) {
  uint16_t tmp;
  tmp = memory_read8(mem, addr);
  tmp += memory_read8(mem, addr + 1) << 8;
  return tmp;
}

void memory_write8(memory_t *mem, uint16_t addr, uint8_t val) {
  switch(addr){
    case JOYP: //boot rom enable register
      mem->memory[addr] = val&0xF0;
      break;
    case BOOT:
      mem->memory[addr] = val;
      mem->inBoot = (val == 0) ? true : false;
      break;
    default:
      mem->memory[addr] = val;
      break;
  }
}

void memory_write16(memory_t *mem, uint16_t addr, uint16_t val) {
  memory_write8(mem, addr +1, (uint8_t)(val >> 8));
  memory_write8(mem, addr, (uint8_t)val & 0xFF);
}
